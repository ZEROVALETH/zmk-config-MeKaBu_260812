#include <zephyr/dt-bindings/input/input-event-codes.h>
#include <input/processors.dtsi>
#include <input/processors/report_rate_limit.dtsi>
#include <input/processors/xyz.dtsi>
#include "../listners.dtsi"

&listner_peripheral {
    status = "okay";
    device = <&split_peripheral>;
    input-processors = <&zip_zxy>;
};